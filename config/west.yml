## config/west.yml
```yaml
manifest:
  remotes:
    - name: zmkfirmware
      url-base: https://github.com/zmkfirmware
    - name: petejohanson
      url-base: https://github.com/petejohanson
    - name: badjeff
      url-base: https://github.com/badjeff
    - name: minhe7735
      url-base: https://github.com/minhe7735
    - name: urob
      url-base: https://github.com/urob
    # Additional modules containing boards/shields/custom code can be listed here as well
    # See https://docs.zephyrproject.org/3.2.0/develop/west/manifest.html#projects
  projects:
    - name: zmk
      remote: petejohanson
      revision: feat/pointers-with-input-processors
      import: app/west.yml
    - name: zmk-pmw3610-driver
      remote: badjeff
      revision: main
    - name: zmk-split-peripheral-input-relay
      remote: badjeff
      revision: main
    - name: zmk-input-behavior-listener
      remote: minhe7735 
      revision: main
    - name: zmk-auto-layer
      remote: urob
      revision: main
      path: modules/auto-layer
    - name: zmk-tri-state
      remote: urob
      revision: main
      path: modules/tri-state
  self:
    path: config
```
